PROTOPIRATE_AM_PROTOCOL(subghz_protocol_alutech_at_4n)
PROTOPIRATE_AM_PROTOCOL(subghz_protocol_beninca_arc)
PROTOPIRATE_AM_PROTOCOL(subghz_protocol_came)
PROTOPIRATE_AM_PROTOCOL(subghz_protocol_came_atomo)
PROTOPIRATE_AM_PROTOCOL(subghz_protocol_came_twee)
PROTOPIRATE_AM_PROTOCOL(subghz_protocol_chamb_code)
PROTOPIRATE_AM_PROTOCOL(subghz_protocol_clemsa)
PROTOPIRATE_AM_PROTOCOL(subghz_protocol_dooya)
PROTOPIRATE_AM_PROTOCOL(subghz_protocol_faac_slh)
PROTOPIRATE_AM_PROTOCOL(subghz_protocol_gate_tx)
PROTOPIRATE_AM_PROTOCOL(subghz_protocol_hormann)
PROTOPIRATE_AM_PROTOCOL(subghz_protocol_keeloq)
PROTOPIRATE_AM_PROTOCOL(subghz_protocol_linear)
PROTOPIRATE_AM_PROTOCOL(subghz_protocol_linear_delta3)
PROTOPIRATE_AM_PROTOCOL(subghz_protocol_megacode)
PROTOPIRATE_AM_PROTOCOL(subghz_protocol_nice_flo)
PROTOPIRATE_AM_PROTOCOL(subghz_protocol_nice_flor_s)
PROTOPIRATE_AM_PROTOCOL(subghz_protocol_princeton)
PROTOPIRATE_AM_PROTOCOL(subghz_protocol_somfy_keytis)
PROTOPIRATE_AM_PROTOCOL(subghz_protocol_somfy_telis)
